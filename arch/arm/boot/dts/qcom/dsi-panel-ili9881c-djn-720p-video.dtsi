/* Copyright (c) 2013, The Linux Foundation. All rights reserved.
 *
 * This program is free software; you can redistribute it and/or modify
 * it under the terms of the GNU General Public License version 2 and
 * only version 2 as published by the Free Software Foundation.
 *
 * This program is distributed in the hope that it will be useful,
 * but WITHOUT ANY WARRANTY; without even the implied warranty of
 * MERCHANTABILITY or FITNESS FOR A PARTICULAR PURPOSE.  See the
 * GNU General Public License for more details.
 */

/*---------------------------------------------------------------------------
 * This file is autogenerated file using gcdb parser. Please do not edit it.
 * Update input XML file to add a new entry or update variable in this file
 * VERSION = "1.0"
 *---------------------------------------------------------------------------*/
&mdss_mdp {
	dsi_ili9881c_djn_720p_video: qcom,mdss_dsi_ili9881c_djn_720p_video {
		qcom,mdss-dsi-panel-name = "ili911c djn 720p video mode dsi panel";
		qcom,mdss-dsi-panel-controller = <&mdss_dsi0>;
		qcom,mdss-dsi-panel-type = "dsi_video_mode";
		qcom,mdss-dsi-panel-destination = "display_1";
		qcom,mdss-dsi-panel-framerate = <60>;
		qcom,mdss-dsi-virtual-channel-id = <0>;
		qcom,mdss-dsi-stream = <0>;
		qcom,mdss-dsi-panel-width = <720>;
		qcom,mdss-dsi-panel-height = <1280>;
		qcom,mdss-dsi-h-front-porch = <80>;
		qcom,mdss-dsi-h-back-porch = <80>;
		qcom,mdss-dsi-h-pulse-width = <60>;
		qcom,mdss-dsi-h-sync-skew = <0>;
		qcom,mdss-dsi-v-back-porch = <14>;
		qcom,mdss-dsi-v-front-porch = <10>;
		qcom,mdss-dsi-v-pulse-width = <4>;
		qcom,mdss-dsi-h-left-border = <0>;
		qcom,mdss-dsi-h-right-border = <0>;
		qcom,mdss-dsi-v-top-border = <0>;
		qcom,mdss-dsi-v-bottom-border = <0>;
		qcom,mdss-dsi-bpp = <24>;
		qcom,mdss-dsi-color-order = "rgb_swap_rgb";
		qcom,mdss-dsi-underflow-color = <0xff>;
		qcom,mdss-dsi-border-color = <0>;
		qcom,mdss-dsi-on-command = [39 01 00 00 00 00 04 FF 98 81 03
		39 01 00 00 00 00	02 01 00
		39 01 00 00 00 00	02 02 00
		39 01 00 00 00 00	02 03 56
		39 01 00 00 00 00	02 04 13
		39 01 00 00 00 00	02 05 00
		39 01 00 00 00 00	02 06 06
		39 01 00 00 00 00	02 07 01
		39 01 00 00 00 00	02 08 00
		39 01 00 00 00 00	02 09 30
		39 01 00 00 00 00	02 0a 01
		39 01 00 00 00 00	02 0b 00
		39 01 00 00 00 00	02 0c 30
		39 01 00 00 00 00	02 0d 01
		39 01 00 00 00 00	02 0e 00
		39 01 00 00 00 00	02 0f 18
		39 01 00 00 00 00	02 10 18
		39 01 00 00 00 00	02 11 00
		39 01 00 00 00 00	02 12 00
		39 01 00 00 00 00	02 13 00
		39 01 00 00 00 00	02 14 00
		39 01 00 00 00 00	02 15 00
		39 01 00 00 00 00	02 16 00
		39 01 00 00 00 00	02 17 00
		39 01 00 00 00 00	02 18 00
		39 01 00 00 00 00	02 19 00
		39 01 00 00 00 00	02 1a 00
		39 01 00 00 00 00	02 1b 00
		39 01 00 00 00 00	02 1c 00
		39 01 00 00 00 00	02 1d 00
		39 01 00 00 00 00	02 1e 40
		39 01 00 00 00 00	02 1f C0
		39 01 00 00 00 00	02 20 02
		39 01 00 00 00 00	02 21 05
		39 01 00 00 00 00	02 22 02
		39 01 00 00 00 00	02 23 00
		39 01 00 00 00 00	02 24 86
		39 01 00 00 00 00	02 25 85
		39 01 00 00 00 00	02 26 00
		39 01 00 00 00 00	02 27 00
		39 01 00 00 00 00	02 28 3B
		39 01 00 00 00 00	02 29 03
		39 01 00 00 00 00	02 2a 00
		39 01 00 00 00 00	02 2b 00
		39 01 00 00 00 00	02 2c 00
		39 01 00 00 00 00	02 2d 00
		39 01 00 00 00 00	02 2e 00
		39 01 00 00 00 00	02 2f 00
		39 01 00 00 00 00	02 30 00
		39 01 00 00 00 00	02 31 00
		39 01 00 00 00 00	02 32 00
		39 01 00 00 00 00	02 33 00
		39 01 00 00 00 00	02 34 00
		39 01 00 00 00 00	02 35 00
		39 01 00 00 00 00	02 36 00
		39 01 00 00 00 00	02 37 00
		39 01 00 00 00 00	02 38 00
		39 01 00 00 00 00	02 39 00
		39 01 00 00 00 00	02 3a 00
		39 01 00 00 00 00	02 3b 00
		39 01 00 00 00 00	02 3c 00
		39 01 00 00 00 00	02 3d 00
		39 01 00 00 00 00	02 3e 00
		39 01 00 00 00 00	02 3f 00
		39 01 00 00 00 00	02 40 00
		39 01 00 00 00 00	02 41 00
		39 01 00 00 00 00	02 42 00
		39 01 00 00 00 00	02 43 00
		39 01 00 00 00 00	02 44 00
		39 01 00 00 00 00	02 50 01
		39 01 00 00 00 00	02 51 23
		39 01 00 00 00 00	02 52 45
		39 01 00 00 00 00	02 53 67
		39 01 00 00 00 00	02 54 89
		39 01 00 00 00 00	02 55 ab
		39 01 00 00 00 00	02 56 01
		39 01 00 00 00 00	02 57 23
		39 01 00 00 00 00	02 58 45
		39 01 00 00 00 00	02 59 67
		39 01 00 00 00 00	02 5a 89
		39 01 00 00 00 00	02 5b ab
		39 01 00 00 00 00	02 5c cd
		39 01 00 00 00 00	02 5d ef
		39 01 00 00 00 00	02 5e 11
		39 01 00 00 00 00	02 5f 08
		39 01 00 00 00 00	02 60 00
		39 01 00 00 00 00	02 61 01
		39 01 00 00 00 00	02 62 02
		39 01 00 00 00 00	02 63 02
		39 01 00 00 00 00	02 64 0F
		39 01 00 00 00 00	02 65 0E
		39 01 00 00 00 00	02 66 0D
		39 01 00 00 00 00	02 67 0C
		39 01 00 00 00 00	02 68 02
		39 01 00 00 00 00	02 69 02
		39 01 00 00 00 00	02 6a 02
		39 01 00 00 00 00	02 6b 02
		39 01 00 00 00 00	02 6c 02
		39 01 00 00 00 00	02 6d 02
		39 01 00 00 00 00	02 6e 06
		39 01 00 00 00 00	02 6f 02
		39 01 00 00 00 00	02 70 02
		39 01 00 00 00 00	02 71 02
		39 01 00 00 00 00	02 72 02
		39 01 00 00 00 00	02 73 02
		39 01 00 00 00 00	02 74 02
		39 01 00 00 00 00	02 75 06
		39 01 00 00 00 00	02 76 00
		39 01 00 00 00 00	02 77 01
		39 01 00 00 00 00	02 78 02
		39 01 00 00 00 00	02 79 02
		39 01 00 00 00 00	02 7a 0F
		39 01 00 00 00 00	02 7b 0E
		39 01 00 00 00 00	02 7c 0D
		39 01 00 00 00 00	02 7d 0C
		39 01 00 00 00 00	02 7e 02
		39 01 00 00 00 00	02 7f 02
		39 01 00 00 00 00	02 80 02
		39 01 00 00 00 00	02 81 02
		39 01 00 00 00 00	02 82 02
		39 01 00 00 00 00	02 83 02
		39 01 00 00 00 00	02 84 08
		39 01 00 00 00 00	02 85 02
		39 01 00 00 00 00	02 86 02
		39 01 00 00 00 00	02 87 02
		39 01 00 00 00 00	02 88 02
		39 01 00 00 00 00	02 89 02
		39 01 00 00 00 00	02 8a 02
		39 01 00 00 00 00	04 ff 98 81 04
		39 01 00 00 00 00	02 6C 15
		39 01 00 00 00 00	02 6E 2B             //#di_pwr_reg=0 VGH clamp 15V
		39 01 00 00 00 00	02 6F 33              // #reg vcl + VGH pumping ratio 3x VGL=-2x      3X=37
		39 01 00 00 00 00	02 8D 15               //#VGL clamp -10V    -15=2F
		39 01 00 00 00 00	02 87 BA              //#ESD
		39 01 00 00 00 00	02 26 76              // #ESD
		39 01 00 00 00 00	02 B2 D1               //#ESD
		39 01 00 00 00 00	02 B5 06               //#GAMMA BIAS LEVEL 
		39 01 00 00 00 00	02 3A A4            //  #power saving 
		39 01 00 00 00 00	04 ff 98 81 01
		39 01 00 00 00 00	02 22 09	          //09  GS  RGB	  //#BGR, SS 0A=FW 09=BW
		39 01 00 00 00 00	02 53 7f		//#VCOM1 FW
		39 01 00 00 00 00	02 55 7C		//#VCOM2 BW
//		39 01 00 00 00 00	02 56 00              //#VCOM READ REGISTER   01 read register
		39 01 00 00 00 00	02 50 B7         	//#VREG1OUT=4.9
		39 01 00 00 00 00	02 51 B7         	//#VREG2OUT=-4.9V
		39 01 00 00 00 00	02 31 00		//#column inversion
		39 01 00 00 00 00	02 60 30	//	#SDT
		39 01 00 00 00 00	02 61 00	//	#CRT
		39 01 00 00 00 00	02 62 19	//	#EQT
		39 01 00 00 00 00	02 63 10	//	#PCT
		39 01 00 00 00 00	02 a0 00	//	#vp255	gamma p
		39 01 00 00 00 00	02 a1 2B      //       #vp251        
		39 01 00 00 00 00	02 a2 39       //        #vp247        
		39 01 00 00 00 00	02 a3 13        //      #vp243        
		39 01 00 00 00 00	02 a4 16        //      #vp239        
		39 01 00 00 00 00	02 a5 28         //      #vp231        
		39 01 00 00 00 00	02 a6 1D          //     #vp219        
		39 01 00 00 00 00	02 a7 1E           //    #vp203        
		39 01 00 00 00 00	02 a8 9E            //   #vp175        
		39 01 00 00 00 00	02 a9 1B            //   #vp144        
		39 01 00 00 00 00	02 aa 27            //   #vp111        
		39 01 00 00 00 00	02 ab 8A           //   #vp80         
		39 01 00 00 00 00	02 ac 1C           //   #vp52         
		39 01 00 00 00 00	02 ad 1B           //    #vp36         
		39 01 00 00 00 00	02 ae 4E            //   #vp24         
		39 01 00 00 00 00	02 af 20           //    #vp16         
		39 01 00 00 00 00	02 b0 28             //  #vp12         
		39 01 00 00 00 00	02 b1 53            //   #vp8          
		39 01 00 00 00 00	02 b2 61            //   #vp4          
		39 01 00 00 00 00	02 b3 39            //   #vp0          
		39 01 00 00 00 00	02 c0 00	//	#vn255 gamma n
		39 01 00 00 00 00	02 c1 2B         //     #vn251        
		39 01 00 00 00 00	02 c2 3a           //    #vn247        
		39 01 00 00 00 00	02 c3 13          //    #vn243        
		39 01 00 00 00 00	02 c4 16           //   #vn239        
		39 01 00 00 00 00	02 c5 29            //   #vn231        
		39 01 00 00 00 00	02 c6 1D           //    #vn219        
		39 01 00 00 00 00	02 c7 1E           //    #vn203        
		39 01 00 00 00 00	02 c8 9F            //   #vn175        
		39 01 00 00 00 00	02 c9 1B            //   #vn144        
		39 01 00 00 00 00	02 ca 29             //  #vn111        
		39 01 00 00 00 00	02 cb 8A           //   #vn80         
		39 01 00 00 00 00	02 cc 1B           //   #vn52         
		39 01 00 00 00 00	02 cd 1B           //    #vn36         
		39 01 00 00 00 00	02 ce 4D            //   #vn24         
		39 01 00 00 00 00	02 cf 22           //   #vn16         
		39 01 00 00 00 00	02 d0 27           //   #vn12         
		39 01 00 00 00 00	02 d1 51           //   #vn8          
		39 01 00 00 00 00	02 d2 62           //   #vn4          
		39 01 00 00 00 00	02 d3 39           //  #vn0
		39 01 00 00 00 00	04 FF 98 81 00
		39 01 00 00 00 00	02 35 00		
		05 01 00 00 78 00      02 11 00 
		05 01 00 00 14 00      02 29 00];
		qcom,mdss-dsi-off-command = [05 01 00 00 0A 00 02 28 00
					05 01 00 00 78 00 02 10 00];
		qcom,mdss-dsi-on-command-state = "dsi_lp_mode";
		qcom,mdss-dsi-off-command-state = "dsi_lp_mode";
		qcom,mdss-dsi-h-sync-pulse = <1>;
		qcom,mdss-dsi-traffic-mode = "burst_mode";
		qcom,mdss-dsi-lane-map = "lane_map_0123";
		qcom,mdss-dsi-bllp-eof-power-mode;
		qcom,mdss-dsi-bllp-power-mode;
		qcom,mdss-dsi-lp11-init;
		qcom,mdss-dsi-lane-0-state;
		qcom,mdss-dsi-lane-1-state;
		qcom,mdss-dsi-lane-2-state;
		qcom,mdss-dsi-lane-3-state;
		qcom,mdss-dsi-panel-timings = [7F 1C 12 00 40 44 16 1E 17 03 04 00];
		qcom,mdss-dsi-panel-status-command = [06 01 00 01 05 00 02 0A 00];
		qcom,mdss-dsi-panel-status-value = <0x9C>;
                  qcom,mdss-dsi-panel-status-command-state = "dsi_lp_mode";
		qcom,mdss-dsi-panel-status-check-mode = "reg_read";
		qcom,mdss-dsi-panel-status-read-length = <1>;
		qcom,mdss-dsi-t-clk-post = <0x04>;
		qcom,mdss-dsi-t-clk-pre = <0x1B>;
		qcom,mdss-dsi-bl-min-level = <1>;
		qcom,mdss-dsi-bl-max-level = <255>;
		qcom,mdss-dsi-dma-trigger = "trigger_sw";
		qcom,mdss-dsi-mdp-trigger = "none";
		qcom,mdss-dsi-bl-pmic-control-type = "bl_ctrl_wled";
		qcom,mdss-dsi-reset-sequence = <1 2>, <0 1>, <1 50>;
	};
};
