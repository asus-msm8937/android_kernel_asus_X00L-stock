/* Copyright (c) 2015, The Linux Foundation. All rights reserved.
 *
 * This program is free software; you can redistribute it and/or modify
 * it under the terms of the GNU General Public License version 2 and
 * only version 2 as published by the Free Software Foundation.
 *
 * This program is distributed in the hope that it will be useful,
 * but WITHOUT ANY WARRANTY; without even the implied warranty of
 * MERCHANTABILITY or FITNESS FOR A PARTICULAR PURPOSE.  See the
 * GNU General Public License for more details.
 */

qcom,guangyu_c11p1511_3000mah {
	/* #GUANGYU_C11P1511_3000mAh_averaged_MasterSlave_Feb21st2017*/
	qcom,max-voltage-uv = <4380000>;
	qcom,nom-batt-capacity-mah = <3000>;
	qcom,batt-id-kohm = <51>;
	qcom,battery-beta = <3430>;
	qcom,battery-type = "C11P1511-O-01-0001-1.1.1";
	qcom,fg-cc-cv-threshold-mv = <4340>;
	qcom,chg-rslow-comp-c1 = <5342247>;
	qcom,chg-rslow-comp-c2 = <12041060>;
	qcom,chg-rs-to-rslow = <1182254>;
	qcom,chg-rslow-comp-thr = <0xC7>;
	qcom,checksum = <0xDB0C>;
	qcom,gui-version = "PMI8950GUI - 2.0.0.16";
	qcom,fg-profile-data = [
		 F3 83 7D 7D
		 75 81 B8 77
		 5F 83 6A 6C
		 92 83 2E 8E
		 1F 82 81 9A
		 BE BD E3 CA
		 5A 0E EA 83
		 AA 7C B7 80
		 1C 76 5B 83
		 E7 59 B5 81
		 15 8E 4C 82
		 DE 99 41 BD
		 57 CA 54 0D
		 AF 0B 94 59
		 14 70 B2 FD
		 43 3F 73 3E
		 DE 33 00 00
		 A4 45 50 2A
		 FE 22 00 00
		 00 00 00 00
		 00 00 00 00
		 6C 6B 24 6A
		 96 4E 96 7B
		 99 6F B0 61
		 B2 62 21 80
		 D5 6D 5A 5B
		 5A 6F BC A1
		 18 E8 62 4C
		 64 A0 71 0C
		 28 00 FF 36
		 F0 11 30 03
		 00 00 00 0C
	];
};
